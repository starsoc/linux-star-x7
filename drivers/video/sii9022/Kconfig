## drivers/video/sii9022/Kconfig
```kconfig
menuconfig SII9022
	bool "Sii9022 HDMI driver support"
	depends on FB
	default y
	help
	  Choose this option if you want to use the MYIR sii902x hdmi
	  for video output.
	  
config SII9022_EDID_READING
	bool "Auto set videomode by reading monitor EDID (untested)"
	depends on SII9022
	default n
	help
	  Choose this to enable videomode auto set by reading
	  monitor EDID. Use system default videomode if unchecked.
```
